## layers/meta-balena-allwinner/conf/machine/olinuxino-a20som.conf
```bitbake
#@TYPE: Machine
#@NAME: olinuxino-a20som
#@DESCRIPTION: Machine configuration for the Olimex A20-SOM Evaluation Board, based on Allwinner A20 CPU
#https://github.com/OLIMEX/SOM

require conf/machine/include/sun7i.inc

KERNEL_DEVICETREE = "sun7i-a20-olimex-som-evb.dtb \
overlay/sun7i-a20-analog-codec.dtbo \
overlay/sun7i-a20-can.dtbo \
overlay/sun7i-a20-i2c1.dtbo \
overlay/sun7i-a20-i2c2.dtbo \
overlay/sun7i-a20-i2c3.dtbo \
overlay/sun7i-a20-i2c4.dtbo \
overlay/sun7i-a20-mmc2.dtbo \
overlay/sun7i-a20-nand.dtbo \
overlay/sun7i-a20-pps-gpio.dtbo \
overlay/sun7i-a20-pwm.dtbo \
overlay/sun7i-a20-spdif-out.dtbo \
overlay/sun7i-a20-spi-add-cs1.dtbo \
overlay/sun7i-a20-spi-jedec-nor.dtbo \
overlay/sun7i-a20-spi-spidev.dtbo \
overlay/sun7i-a20-uart2.dtbo \
overlay/sun7i-a20-uart3.dtbo \
overlay/sun7i-a20-uart4.dtbo \
overlay/sun7i-a20-uart5.dtbo \
overlay/sun7i-a20-uart6.dtbo \
overlay/sun7i-a20-uart7.dtbo \
overlay/sun7i-a20-w1-gpio.dtbo \
"

UBOOT_MACHINE = "A20-Olimex-SOM-EVB_config"
SUNXI_FEX_FILE = "sys_config/a20/olimex_a20_som.fex"
```
